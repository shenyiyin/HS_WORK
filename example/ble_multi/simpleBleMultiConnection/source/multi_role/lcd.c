#include "lcd.h"
#include "spi.h"
#include "log.h"
#include "string.h"
#include "ll.h"
#include "PAT.h"
#include "OSAL.h"
#include "OSAL_PwrMgr.h"
#include "pwrmgr.h"
#include "buzz.h"
//#include "simpleBLEPeripheral.h"
#include "sf_i2c.h"
#include "user_app.h"


#define CS0 GPIO_P34
#define RS GPIO_P00
#define LCD_SCL GPIO_P32
#define LCD_SDA GPIO_P33

#define SLAVE_LCD 0x78


// 全局变量，存储上一次的时间
uint8_t last_hour_tens = 0;
uint8_t last_hour_units = 0;
uint8_t last_min_tens = 0;
uint8_t last_min_units = 0;
uint8_t low_power_mode=0;


const   uint8_t mh[]={

	0x00,0x00,0x00,0x00,0x00,0x40,0x00,0x00,0x00,0x00,0x00,0x00,0x00,0x06,0x00,0x00,/*":",0*/
};

const   uint8_t shuzi[][16*9] = {

0x00,0x00,0x00,0x00,0x00,0x00,0x00,0x00,0x00,0x00,0x00,0x00,0x00,0x00,0x00,0x00,
0x00,0x00,0x00,0x00,0x00,0x00,0x00,0x00,0x00,0x00,0x00,0x80,0xE0,0xF0,0x3C,0x0E,
0x06,0x03,0x01,0x01,0x01,0x01,0x03,0x02,0x0E,0x3C,0xF8,0xE0,0x80,0x00,0x00,0x00,
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0x01,0x01,0x01,0x01,0x01,0x00,0x00,0x00,0x00,0x00,0x00,0x00,0x00,0x00,0x00,0x00,/*"9",8*/

};

const   uint8_t flag_cm[][16] = {
0x80,0x80,0x80,0x80,0x80,0x80,0x80,0x00,0x20,0x3F,0x20,0x00,0x3F,0x20,0x00,0x3F,/*"m",0*/

0x00,0x10,0x10,0xF8,0x00,0x00,0x00,0x00,0x00,0x20,0x20,0x3F,0x20,0x20,0x00,0x00,/*"l",1*/
};



const   uint8_t wd[] = {
  0x06,0x09,0x09,0xE6,0xF8,0x0C,0x04,0x02,0x02,0x02,0x02,0x02,0x04,0x1E,0x00,0x00,
	0x00,0x00,0x00,0x07,0x1F,0x30,0x20,0x40,0x40,0x40,0x40,0x40,0x20,0x10,0x00,0x00,/*"℃",0*/
};



const  uint8_t zero[50]={0};

i2c_drv_struct_t lcd_i2c_drv =
{
    .scl = LCD_SCL,
    .sda = LCD_SDA,
};


void lcd_i2c_init(void)
{
	i2c_drv_struct_t *dev=&lcd_i2c_drv;
	LOG("lcd i2c sfoft demo start...\n");
	hal_gpio_pin_init(RS,OEN);
	hal_gpio_pull_set(RS,STRONG_PULL_UP);
	
	hal_gpio_pin_init(LCD_SDA,OEN);
	hal_gpio_pin_init(LCD_SCL,OEN);
	hal_gpio_pull_set(LCD_SCL,STRONG_PULL_UP);
	hal_gpio_pull_set(LCD_SDA,STRONG_PULL_UP);

	hal_gpio_fast_write(LCD_SDA,1);
	hal_gpio_fast_write(LCD_SCL,1);

	LOG("lcd i2c sfoft demo start  ok...\n");
}


static uint8 LCD_TaskID;   // Task ID for internal task/event processing

int32_t lcd_I2C_Read( uint8_t Reg, uint8_t *pBuff, uint16_t nBuffSize)
{

	i2c_read_multi_byte(&lcd_i2c_drv, SLAVE_LCD, Reg, pBuff, nBuffSize);
  return 0;
}


int32_t lcd_I2C_Write(uint8_t Reg, uint8_t *pBuff, uint16_t nBuffSize)
{
	

	i2c_write_multi_byte(&lcd_i2c_drv, SLAVE_LCD, Reg, pBuff, nBuffSize);

  return 0;
}

int32_t lcd_I2C_Write_Single(uint8_t Reg, uint8_t data)
{
	uint8_t temp[1]={data};
	
	i2c_write_multi_byte(&lcd_i2c_drv, SLAVE_LCD, Reg, temp, 1);
	
  return 0;
}

void write_com(uint8_t cmd)
{
    lcd_I2C_Write_Single(0x00, cmd);
}

void write_data(uint8_t dat)
{
    lcd_I2C_Write_Single(0x40, dat);
}


void lcd_address(unsigned char page,unsigned char column)
{
	column=column-1; //我们平常所说的第 1 列，在 LCD 驱动 IC 里是第 0 列。所以在这里减去 1.
	page=page-1;
	write_com(0xb0+page); //设置页地址。每页是 8 行。一个画面的 64 行被分成 8 个页。我们平常所说的第 1 页，在 LCD 驱动IC 里是第 0 页，所以在这里减去 1
	write_com(((column>>4)&0x0f)+0x10); //设置列地址的高 4 位
	write_com(column&0x0f); //设置列地址的低 4 位
}

void test(unsigned char data1,unsigned char data2)
{
	int i,j;
	for(i=0;i<8;i++)
	{
		lcd_address(i+1,1);
		for(j=0;j<64;j++)
		{
			write_data(data1);
			write_data(data2);
		}
	}
}


/*显示6x12点阵图像、汉字、生僻字或16x16点阵的其他图标*/
void hanzi_6x12(uint8_t page,uint8_t column,uint8_t reverse,const uint8_t *dp)
{
	uint8_t i,j;
	for(j=0;j<2;j++)
	{
		lcd_address(page+j,column);
		for (i=0;i<6;i++)
		{
			if(reverse==1)
			{
				write_data(*dp); /*写数据到LCD,每写完一个8位的数据后列地址自动加1*/
			}
			else
				write_data(~*dp);
			dp++;
		}
	}
}


void hanzi_16x12(uint8_t page,uint8_t column,uint8_t reverse,const uint8_t  *dp)
{
	uint8_t i,j;
	for(j=0;j<2;j++)
	{
		lcd_address(page+j,column);
		for (i=0;i<12;i++)
		{
			if(reverse==1)
			{
				write_data(*dp); /*写数据到LCD,每写完一个8位的数据后列地址自动加1*/
			}
			else
				write_data(~*dp);
			dp++;
		}
	}
}

//24x42

void hanzi_16x48(uint8_t page, uint8_t column, uint8_t reverse, const uint8_t *dp)
{
	uint8_t i, j;
	for(j = 0; j <6; j++)
	{
		lcd_address(page+j, column);
		for(i = 0; i < 24; i++)
		{
			if(reverse == 1)
			{
				write_data(*dp);
			}
			else
			{
				write_data(~*dp);
			}
			dp++;
		}
	}
}
/*显示16x16点阵图像、汉字、生僻字或16x16点阵的其他图标*/
void hanzi_8x16(unsigned char page,unsigned char column,unsigned char reverse,const unsigned char  *dp)
{
	unsigned char i,j;
	for(j=0;j<2;j++)
	{
		lcd_address(page+j,column);
		for (i=0;i<8;i++)
		{
			if(reverse==1)
			{
				write_data(*dp); /*写数据到LCD,每写完一个8位的数据后列地址自动加1*/
			}
			else
				write_data(~*dp);
			dp++;
		}
	}
}



/*显示16x16点阵图像、汉字、生僻字或16x16点阵的其他图标*/
void hanzi_8x32(unsigned char page,unsigned char column,unsigned char reverse,const unsigned char  *dp)
{
	unsigned char i,j;
	for(j=0;j<4;j++)
	{
		lcd_address(page+j,column);
		for (i=0;i<4;i++)
		{
			if(reverse==1)
			{
				write_data(*dp); /*写数据到LCD,每写完一个8位的数据后列地址自动加1*/
			}
			else
				write_data(~*dp);
			dp++;
		}
	}
}

/*显示16x16点阵图像、汉字、生僻字或16x16点阵的其他图标*/
void hanzi_16x16(unsigned char page,unsigned char column,unsigned char reverse,const unsigned char  *dp)
{
	unsigned char i,j;
	for(j=0;j<2;j++)
	{
		lcd_address(page+j,column);
		for (i=0;i<16;i++)
		{
			if(reverse==1)
			{
				write_data(*dp); /*写数据到LCD,每写完一个8位的数据后列地址自动加1*/
			}
			else
				write_data(~*dp);
			dp++;
		}
	}
}
//OLED 显示模块初始化
void Init_SSD1315Z()
{
	lcd_i2c_init();
	hal_gpio_fast_write(RS, 1);
	delay_ms(30);
	hal_gpio_fast_write(RS, 0);
	delay_ms(160);
	hal_gpio_fast_write(RS, 1);
	delay_ms(80);
	dbg_printf("reset finish!\n");
	write_com(0xAE); //Set Display Off
	write_com(0xD5); //Display divide ratio/osc. freq. mode
	write_com(0x80);
	write_com(0xA8); //Multiplex ration mode:63
	write_com(0x3F);
	write_com(0xD3); //Set Display Offset
	write_com(0x00);
	write_com(0x40); //Set Display Start Line
	write_com(0x8D); //DC-DC Control Mode Set
	write_com(0x14); //DC-DC ON/OFF Mode Set
	write_com(0xA0); //Segment Remap
	write_com(0xC0); //Set COM Output Scan Direction
	write_com(0xDA); //Set COM Pins Hardware Configuration
	write_com(0x12);
	write_com(0x81); //Contrast control
	write_com(0x80);
	write_com(0xD9); //Set pre-charge period
	write_com(0x22);
	write_com(0xDB); //VCOM deselect level mode
	write_com(0x40);
	write_com(0xA4); //Set Entire Display On/Off
	write_com(0xA6); //Set Normal Display
	test(0,0);
	show_cm();
//	hanzi_16x48(2,25,1,shuzi[1]);
//	hanzi_16x48(2,49,1,shuzi[2]);
//	hanzi_16x48(2,74,1,shuzi[3]);
//	hanzi_16x48(2,99,1,shuzi[4]);
	//hanzi_16x16(4,29,1,zhen);

//	hanzi_16x12(1,34,1,yan);
//	hanzi_16x12(1,47,1,fa);
	write_com(0xAF); //Set Display On
	dbg_printf("reset finish1!\n");
}

void show_cm(void)
{
	HAL_ENTER_CRITICAL_SECTION();
	//test(0,0);
	hanzi_16x16(5,3,1,zero);
	
	hanzi_8x16(2,3,1,flag_cm[0]);
	hanzi_8x16(2,12,1,flag_cm[1]);

	hanzi_16x48(2,25,1,shuzi[last_hour_tens]);
	hanzi_16x48(2,49,1,shuzi[last_hour_units]);
	hanzi_8x32(2,74,1,mh);
	hanzi_16x48(2,79,1,shuzi[last_min_tens]);
	hanzi_16x48(2,103,1,shuzi[last_min_units]);
	HAL_EXIT_CRITICAL_SECTION();
}

void show_tp(void)
{

	HAL_ENTER_CRITICAL_SECTION();
	hanzi_8x16(2,3,1,zero);
	hanzi_8x16(2,12,1,zero);
	//test(0,0);
	hanzi_16x16(5,3,1,wd);

	hanzi_16x48(2,25,1,shuzi[last_hour_tens]);
	hanzi_16x48(2,49,1,shuzi[last_hour_units]);
	hanzi_8x32(2,74,1,mh);
	hanzi_16x48(2,79,1,shuzi[last_min_tens]);
	hanzi_16x48(2,103,1,shuzi[last_min_units]);
	HAL_EXIT_CRITICAL_SECTION();
}



void show(uint32_t ts)
{
    uint32_t hours = ts / 60;
    uint32_t minutes = (ts % 60);

    uint32_t hour_tens = hours / 10;
    uint32_t hour_units = hours % 10;
    uint32_t min_tens = minutes / 10;
    uint32_t min_units = minutes % 10;

    // 检查小时和分钟是否有变化，如果有则更新显示
    if(hour_tens != last_hour_tens) {
        hanzi_16x48(2,25,1,shuzi[hour_tens]);
        last_hour_tens = hour_tens; // 更新存储的小时十位
    }
    if(hour_units != last_hour_units) {
        hanzi_16x48(2,49,1,shuzi[hour_units]);
        last_hour_units = hour_units; // 更新存储的小时个位
    }
    if(min_tens != last_min_tens) {
        hanzi_16x48(2,79,1,shuzi[min_tens]);
        last_min_tens = min_tens; // 更新存储的分钟十位
    }
    if(min_units != last_min_units) {
        hanzi_16x48(2,103,1,shuzi[min_units]);
        last_min_units = min_units; // 更新存储的分钟个位
    }
}

void Delay(unsigned int dly)
{
    unsigned int i,j;

    for(i=0;i<dly;i++)
    	for(j=0;j<255;j++);
}



void OLED_DisPlay_On(void)
{
    write_com(0x8D); // 电荷泵使能
    write_com(0x14); // 开启电荷泵
    write_com(0xAF); // 点亮屏幕
}

/**
 * @brief 关闭OLED显示，功耗 29 mW
 *
 */
void OLED_DisPlay_Off(void)
{
    write_com(0x8D); // 电荷泵使能
    write_com(0x10); // 关闭电荷泵
    write_com(0xAF); // 关闭屏幕
}

void lcd_enter_sleep(void)
{
	OLED_DisPlay_Off();
	//stop_output(&lcd_i2c_drv);
	hal_gpioretention_register(RS);
	hal_gpioretention_register(LCD_SCL);
	hal_gpioretention_register(LCD_SDA);
	
}

void lcd_exit_sleep(void)
{
		lcd_i2c_init();
		WaitMs(1);
		OLED_DisPlay_On();
		dbg_printf("lcd_exit_sleep\n");
}

void common_sleep_enter(void)
{
	if(low_power_mode==2)
	{
		low_power_mode=1;
		lcd_enter_sleep();
		user_enter_sleep();
		Rotate_Sensor_Into_Lowpower();
	}
		//stop_advertise();
	dbg_printf("enter\n");


}

void common_sleep_exit(void)
{
	if(low_power_mode==1)
	{
		dbg_printf("exit\n");
		hal_pwrmgr_lock(MOD_USR1);
		low_power_mode=0;
		//start_advertise();
		osal_start_timerEx(LCD_TaskID, lcd_event_id, 50);
		user_exit_sleep();
		Rotate_Sensor_Out_Lowpower();
		lcd_exit_sleep();
		lcd_exit_sleep();
	}
	dbg_printf("common_sleep_exit\n");
}

void lcd_init(uint8_t task_id)
{
	LCD_TaskID=task_id;
	hal_pwrmgr_register(MOD_USR1, common_sleep_enter, NULL);
	hal_pwrmgr_lock(MOD_USR1);
	Init_SSD1315Z();
	osal_set_event( LCD_TaskID, lcd_event_id );	
	osal_start_timerEx(LCD_TaskID, lcd_event_id, 50);
}
uint16_t cnt=0;
extern Dial_Control DC;
uint16 lcd_ProcessEvent( uint8 task_id, uint16 events )
{
	static uint32_t timestamp=0;
	static short angle=0xFFF;
//	dbg_printf("cnt=%d!\n",cnt);
	if ( events & lcd_event_id )
	{
		if(!low_power_mode)
		{
			show(DC.percent);
			timestamp+=1;
			short temp_angle=angle_get();
//			if(temp_angle!=0xFFF)
//			{
//				dbg_printf("angle_get=%d!\n",temp_angle);
//			}			
			osal_start_timerEx(LCD_TaskID, lcd_event_id, 50);
			if(cnt>100)
			{
				low_power_mode=2;
				//stop_advertise();
				osal_stop_timerEx(LCD_TaskID, lcd_event_id);
				cnt=0;
				hal_pwrmgr_unlock(MOD_USR1);
			}
			cnt++;
		}
		return (events ^ lcd_event_id);
	}
	return 0;
}

